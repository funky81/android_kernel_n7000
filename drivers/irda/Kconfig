## drivers/irda/Kconfig
```kconfig
#
# IR_LED
#
menuconfig IR_REMOCON
	bool "IR LED driver only for the remote control"
	help
	  This option doesn't affect the kernel.

	  If unsure, say N.

config IR_REMOCON_GPIO_EUR
	bool "GPIO-based IR LED driver of EUR model"
	depends on IR_REMOCON && IR_REMOCON_GPIO
	default n
	help
	  Say Y here to enable the GPIO-based driver for IR_LED of EUR model.
```
